## drivers/usb/mtk_brom/Kconfig
```kconfig
config USB_MTK_BROM
	tristate "MediaTek BROM USB driver"
	depends on USB
	help
	  Minimal USB driver for MediaTek BootROM devices
	  with VID:PID 0e8d:0003.
```
